/*
  A simple Unity communication example using the Unity script (ArduinoController.cs) provided for GAME 202.
  Sends a new set of values every loop via Serial.println() to Unity, and reads a response byte back from Unity which is used to determine which LEDs to turn on/off

  Created by Eddie Melcer for the Foundations of Alternative Controller Games course

  This example code is available under Creative Commons Attribution 4.0 International Public License.
*/

// Our LED pins
int led1Pin = 12;
int led2Pin = 9;
int led3Pin = 7;

// A counter variable which we will use to continuously change what value we are sending to Unity
int counter = 0;

void setup() {
  // Setup serial communication
  Serial.begin(9600);
  
  // Setup our LED pins for output
  pinMode(led1Pin, OUTPUT);
  pinMode(led2Pin, OUTPUT);
  pinMode(led3Pin, OUTPUT);
}

void loop() {
  // Do we have data available via serial from Unity?
  if (Serial.available() > 0) {
    // read the incoming byte from Unity telling us which LED to light p
    int control = Serial.read();
    
    // If the control byte is 0, turn on the first LED and turn the others off
    if(control == 0){
      digitalWrite(led1Pin, HIGH);
      digitalWrite(led2Pin, LOW);
      digitalWrite(led3Pin, LOW);
    }
    // Otherwise, if the control byte is 1, turn on the second LED and turn the others off
    else if(control == 1){
      digitalWrite(led1Pin, LOW);
      digitalWrite(led2Pin, HIGH);
      digitalWrite(led3Pin, LOW);
    }
    // Otherwise, if the control byte is 2, turn on the third LED and turn the others off
    else if(control == 2){
      digitalWrite(led1Pin, LOW);
      digitalWrite(led2Pin, LOW);
      digitalWrite(led3Pin, HIGH);
    }
    // Otherwise something went horribly wrong with the serial communication and turn off all the LEDs to indicate so
    else{
      digitalWrite(led1Pin, LOW);
      digitalWrite(led2Pin, LOW);      
      digitalWrite(led3Pin, LOW);
    }
  }
  
  // Depending on what the current counter is, send a set of values in string form to Unity via println
  // Even if we are only sending 1 value to Unity, we should still use println based on the way the Unity communication library handles reads values
  if(counter == 0){
    Serial.println("1,0,0");
  }else if(counter == 1){
    Serial.println("0,1,0");    
  }else{
    Serial.println("0,0,1");    
  }
  
  // Increment our counter so we send a new set of values the next time through the loop
  counter++;

  // The counter values should only ever be 0, 1, or 2
  // We can enforce this using the % operator
  counter = counter % 3;
  
  // Wait long enough to see the effects in Unity and the corresponding LED light up before starting a new loop
  delay(50);
}
